## esp32/firmware/main/Kconfig.projbuild
```kconfig
menu "Ito"

    config ITOFS_FRONTEND
        bool "On-chip text front end: the `text <string>` command (normalization + espeak-ng G2P on the chip)"
        default y
        help
            Adds esp32/frontend: text normalization and grapheme-to-phoneme conversion (espeak-ng 1.52.0, en-us) on the chip, producing the
            same token ids as the host front end, so no computer is needed. About 273 KB of flash for the data, about 190 KB of PSRAM, and
            very little internal SRAM (the translator's static data and heap go to PSRAM; the task stack is in PSRAM too). See esp32/FRONTEND.md.

    config ITOFS_FE_FAST_FIRST
        bool "Speak the first sentence alone (lowest latency)"
        depends on ITOFS_FRONTEND
        default y
        help
            tools/say.py merges consecutive short sentences into one utterance of up to 200 tokens; to merge, the second sentence has to be
            phonemized before the first utterance can start. With this option the first sentence is sent on its own and only the following ones are merged.
            Off: exactly the utterances of tools/say.py (a second sentence is phonemized before the first audio).

    config ITOFS_BOOT_TEXT
        bool "At boot, speak the phrase list in main/phrases.txt (text stored in flash, no host)"
        depends on ITOFS_FRONTEND
        default n
        help
            One phrase per line, '#' starts a comment. Each phrase goes through the on-chip front end and is spoken after the boot calibration,
            like CONFIG_ITOFS_BOOT_DEMOS does for the three demo sentences. The `phrases` command speaks the list again.

    config ITOFS_BOOT_TEXT_SILENT
        bool "... but compute only: no playback (prints timing and the PCM hash)"
        depends on ITOFS_BOOT_TEXT
        default n
        help
            For tests: the boot phrases are synthesized into memory instead of being played (the I2S and the codec are not used).

    config ITOFS_AUTOTEST
        bool "Stand-alone test: run the texts of the `texts` partition on the chip and log per-utterance results in `results`"
        depends on ITOFS_FRONTEND
        default n
        help
            After boot the chip reads English texts from the data partition `texts` (frontend/tools/make_texts_bin.py), runs normalization, espeak-ng
            phonemization and the Ito synthesis on the chip (no I2S: the playout clock is emulated) and appends one 64-byte record per utterance
            (ids hash, front-end time, first chunk, RTF, PCM hash, underruns, heap) to the data partition `results` (frontend/tools/read_results.py).
            No computer is needed while it runs. The run is finished when a done record exists; erase `results` to run again.

    config ITOFS_AUTOTEST_QUIET
        bool "... and write nothing to the console while it runs (stdout is discarded until the run is over)"
        depends on ITOFS_AUTOTEST
        default n

    config ITOFS_AUTOTEST_LOOP_BOOTS
        int "Reboot-loop mode: number of boots (0 = one run through all the texts)"
        depends on ITOFS_AUTOTEST
        default 0
        help
            With N > 0 every boot runs ITOFS_AUTOTEST_LOOP_TEXTS texts (starting where the previous boot stopped), appends its records and, if
            ITOFS_AUTOTEST_SELFRESET is set, restarts the chip; after N boots a done record ends the loop.

    config ITOFS_AUTOTEST_LOOP_TEXTS
        int "Reboot-loop mode: texts per boot"
        depends on ITOFS_AUTOTEST
        default 4

    config ITOFS_AUTOTEST_SELFRESET
        bool "Reboot-loop mode: the firmware restarts itself (esp_restart) after each boot's texts"
        depends on ITOFS_AUTOTEST
        default y

    config ITOFS_AUTOTEST_WDT_RESETS
        bool "Reboot-loop mode: every second reset is a hardware-watchdog reset (the firmware stops feeding it) instead of esp_restart"
        depends on ITOFS_AUTOTEST_SELFRESET
        default n
        help
            A watchdog reset counts against the full split (it latches the row split until `split auto`); results stay identical, only slower.

    config ITOFS_BOOT_DEMOS
        bool "Speak the three demo sentences at every boot"
        default n
        help
            Off (the default): the board boots silent, measures itself and prints READY; the demos play only when asked (`demo`, or the BOOT button).
            On: after the boot calibration the three demo sentences are spoken, as in earlier releases.

    config ITOFS_APPROVE_LIGHT
        bool "Treat the light weight sets of every voice as judged equivalent by ear"
        default n
        help
            The boot measures every weight set and, among the sets that meet the speed target, picks the one with the lowest planned start delay, but only
            among the sets validated by ear for their voice (esp32/engine/itofs_equiv.c: male main, int4 and light; female main and int4). The female light
            set is not validated yet, so by default it is used only when no validated set meets the speed target. Turn this on (or send `equiv light on` on the
            console, which stores the choice in NVS) once the female light set has been approved by listening. An unknown blob (a retrained voice) is never on the list.

    choice ITOFS_SPLIT_POLICY
        prompt "Initial policy of the GEMM split"
        default ITOFS_SPLIT_AUTO
        help
            The int8 GEMM runs either as the row split (core 0 only; the row-parallel loops use both cores) or as the full split (both cores in the
            GEMM, about 28 % faster, but dense SIMD on both cores can collapse the 3.3 V rail of a board with a weak regulator or too little bulk
            capacitance: hangs, brownout resets or wrong results). The output is bit-identical in both.

            This is the policy for a board whose NVS holds no record (first boot, or after erasing it); afterwards the stored record decides, and the
            console command `split auto|row|full` changes it. See esp32/DUAL_CORE_POWER.md.

        config ITOFS_SPLIT_AUTO
            bool "Auto: row split until a supply self-test has passed, then the full split"
        config ITOFS_SPLIT_ROW
            bool "Row split only (the full split can still be forced with `split full`)"
        config ITOFS_SPLIT_FULL
            bool "Full split without a test (a brownout, watchdog or hash failure still latches the row split)"
    endchoice

    choice ITOFS_AUDIO_OUT
        prompt "Audio output"
        default ITOFS_AUDIO_PLAIN_I2S
        help
            Where the 24 kHz audio goes. A plain I2S DAC or class-D amplifier (MAX98357A and the like) needs no setup: BCLK GPIO15, LRCLK GPIO16,
            DOUT GPIO17, no master clock, and no I2C access. The ESP_S3-AUDIN shield has an ES8388 codec that must be configured over I2C and fed a master clock;
            only that choice touches the I2C and MCLK pins. If the codec does not answer, the firmware prints an error and runs on without sound.

        config ITOFS_AUDIO_PLAIN_I2S
            bool "Plain I2S DAC or amplifier (GPIO15 / 16 / 17)"
        config ITOFS_AUDIO_ES8388
            bool "ES8388 codec on the ESP_S3-AUDIN shield"
    endchoice

    if ITOFS_AUDIO_ES8388
        comment "Defaults are the ESP_S3-AUDIN shield on an ESP32-S3-DevKitC-1 N16R8. GPIO3 and GPIO46 are strapping pins (read at reset, free afterwards); GPIO0 (BOOT), 19/20 (USB) and 35-37 (octal PSRAM) must not be used."
        config ITOFS_ES8388_PIN_SDA
            int "I2C SDA GPIO"
            range 1 48
            default 14
        config ITOFS_ES8388_PIN_SCL
            int "I2C SCL GPIO"
            range 1 48
            default 47
        config ITOFS_ES8388_PIN_MCLK
            int "I2S MCLK GPIO (256 x fs = 6.144 MHz)"
            range 1 48
            default 8
        config ITOFS_ES8388_PIN_BCLK
            int "I2S BCLK GPIO (strapping pin GPIO3 on the shield)"
            range 1 48
            default 3
        config ITOFS_ES8388_PIN_WS
            int "I2S LRCK GPIO"
            range 1 48
            default 9
        config ITOFS_ES8388_PIN_DOUT
            int "I2S data to the codec (DSDIN) GPIO (strapping pin GPIO46 on the shield)"
            range 1 48
            default 46
        config ITOFS_AUDIO_VOLUME
            int "Default output volume in percent (0..100; 91 = 0 dB at the codec, 100 = +4.5 dB)"
            range 0 100
            default 91
            help
                The codec's analogue output gain. 0 dB is the loudest setting that cannot clip the DAC with the engine's PCM (its peaks reach about 92 % of full scale).
                The console command `volume <0-100>` changes it at run time.
        config ITOFS_AUDIO_LOOPBACK
            bool "Test only: record the shield's microphones through the codec ADC (command `loopback`)"
            default n
            help
                Compiled out of a production build. Adds an I2S receive channel on GPIO10 and the `loopback` / `micsel` / `micgain` commands, which play a demo sentence
                and measure level, noise floor, clicks, dropouts and the delay from the first DAC sample to the first sound at the microphones.
        config ITOFS_ES8388_PIN_DIN
            int "I2S data from the codec's ADC (ASDOUT) GPIO, loopback only"
            depends on ITOFS_AUDIO_LOOPBACK
            default 10
    endif

endmenu
```
